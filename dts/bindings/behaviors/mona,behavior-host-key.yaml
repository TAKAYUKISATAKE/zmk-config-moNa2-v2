## dts/bindings/behaviors/mona,behavior-host-key.yaml
```yaml
# SPDX-License-Identifier: MIT

description: Key press that selects a HID keycode for the current Bluetooth host slot
compatible: "mona,behavior-host-key"
include: two_param.yaml
```
